## projects/auxiliary_controller/components/gps/Kconfig
```kconfig
menu "UWA Jetski — GPS (Neo-6M UART)"
    config GPS_UART_PORT_NUM
        int "UART port"
        range 0 2
        default 1

    config GPS_UART_BAUD
        int "Baud rate"
        default 9600

    config GPS_UART_RX_GPIO
        int "MCU RX GPIO — connect to Neo-6M TX"
        range 0 48
        default 21

    config GPS_UART_TX_GPIO
        int "MCU TX GPIO to Neo-6M RX, or -1 if not wired"
        range -1 48
        default -1
endmenu
```

## projects/auxiliary_controller/components/joystick/Kconfig.projbuild
```kconfig
menu "UWA Jetski - Joystick potentiometers"

    comment "Y axis (up/down)"

    config JOYSTICK_Y_GPIO
        int "Y pot ADC GPIO"
        range 1 48
        default 19

    config JOYSTICK_Y_ADC_MIN
        int "Y pot raw ADC at 0% (full down)"
        default 0

    config JOYSTICK_Y_ADC_ZERO
        int "Y pot raw ADC at 50% (centre)"
        default 2047
        help
            ADC reading when the stick is centred. Always maps to exactly 50%.
            The range below this scales to 0..50% and above scales to 50..100%,
            so an off-centre physical zero does not introduce a dead-band or offset.

    config JOYSTICK_Y_ADC_MAX
        int "Y pot raw ADC at 100% (full up)"
        default 4095

endmenu
```

## projects/auxiliary_controller/components/rudder_pot/Kconfig
```kconfig
menu "UWA Jetski — Rudder potentiometer"
    config POT_GPIO_NUM
        int "ADC GPIO (rudder pot wiper)"
        range 1 48
        default 18

    config POT_ADC_RAW_MIN
        int "Raw ADC at 0%%"
        default 0

    config POT_ADC_RAW_MAX
        int "Raw ADC at 100%%"
        default 4095
endmenu
```

## projects/auxiliary_controller/main/Kconfig.projbuild
```kconfig
menu "Auxiliary controller — Neo-6M UART"
    config GPS_UART_PORT_NUM
        int "UART port"
        range 0 2
        default 1

    config GPS_UART_RX_GPIO
        int "GPS RX GPIO (connect to module TX)"
        range 0 48
        default 18

    config GPS_UART_TX_GPIO
        int "GPS TX GPIO (connect to module RX, optional)"
        range 0 48
        default 17

    config GPS_UART_BAUD
        int "UART baud rate"
        default 9600

endmenu

menu "Auxiliary controller — rudder potentiometer ADC"
    config POT_ADC_UNIT
        int "ADC unit (1 or 2 on ESP32-S3)"
        range 1 2
        default 1

    config POT_GPIO_NUM
        int "GPIO for ADC potentiometer"
        range 1 48
        default 7

    config POT_ADC_RAW_MIN
        int "Raw ADC at 0%%"
        default 0

    config POT_ADC_RAW_MAX
        int "Raw ADC at 100%%"
        default 4095

endmenu
```

## projects/main_controller/components/height/Kconfig.projbuild
```kconfig
menu "UWA Jetski — Height sensor (A02YYUW) configuration"
    config HEIGHT_SKIP_HW
        bool "Disable A02YYUW hardware init"
        default n

    config HEIGHT_UART_PORT
        int "UART port number for A02YYUW"
        default 2
        help
            UART port used to receive data from the A02YYUW ultrasonic sensor.

    config HEIGHT_UART_RX_GPIO
        int "UART RX GPIO pin for A02YYUW"
        default 12
        help
            GPIO pin connected to the A02YYUW sensor TX pin.

    config HEIGHT_UART_TX_GPIO
        int "UART TX GPIO pin for A02YYUW"
        default 13
        help
            GPIO pin connected to the A02YYUW sensor RX/mode-select pin.

endmenu
```

## projects/main_controller/components/imu/Kconfig.projbuild
```kconfig
menu "UWA Jetski - IMU configuration"

    config IMU_I2C_PORT
        int "IMU I2C port"
        range 0 1
        default 0
        help
            ESP-IDF I2C controller number used by the IMU component.

    config IMU_I2C_SDA_GPIO
        int "IMU I2C SDA GPIO"
        range 0 48
        default 16
        help
            SDA pin for the IMU I2C bus.

    config IMU_I2C_SCL_GPIO
        int "IMU I2C SCL GPIO"
        range 0 48
        default 21
        help
            SCL pin for the IMU I2C bus.

    config IMU_I2C_FREQ_HZ
        int "IMU I2C bus frequency (Hz)"
        range 10000 1000000
        default 400000
        help
            I2C clock frequency used for IMU communication.

    config IMU_I2C_ADDRESS
        hex "ICM20948 I2C address"
        range 0x00 0x7F
        default 0x69
        help
            I2C address of the ICM20948 device (usually 0x68 or 0x69).
endmenu
```

## projects/main_controller/components/servo_drive/Kconfig
```kconfig
menu "UWA Jetski — Rudder PWM (LEDC)"

    config SERVO_A_GPIO
        int "Channel A PWM GPIO"
        range 1 48
        default 1

    config SERVO_B_GPIO
        int "Channel B PWM GPIO"
        range 1 48
        default 2

    config SERVO_LEDC_TIMER_IDX
        int "LEDC timer index (0–3)"
        range 0 3
        default 0

    config SERVO_LEDC_CHANNEL_A
        int "LEDC channel A"
        range 0 7
        default 0

    config SERVO_LEDC_CHANNEL_B
        int "LEDC channel B"
        range 0 7
        default 1
endmenu
```

## projects/main_controller/components/servo_drive/Kconfig.projbuild
```kconfig
menu "UWA Jetski — Direct PWM Servos"
    config SERVO_SKIP_HW
        bool "Disable servo hardware init"
        default n
endmenu
```

## projects/main_controller/components/webui/Kconfig.projbuild
```kconfig
menu "WebUI Configuration"

    config WEBUI_AP_SSID
        string "WiFi AP SSID"
        default "Jetski-Control"
        help
            SSID of the open WiFi access point.

    config WEBUI_AP_CHANNEL
        int "WiFi AP channel"
        range 1 11
        default 6
        help
            WiFi channel (1-11).

    config WEBUI_AP_MAX_CONN
        int "Max WiFi clients"
        range 1 8
        default 4
        help
            Maximum number of simultaneous WiFi clients.

    config WEBUI_HTTP_PORT
        int "HTTP server port"
        default 80
        help
            Port for the HTTP configuration server.

endmenu
```

## projects/main_controller/main/Kconfig.projbuild
```kconfig
menu "Main controller — servo PWM"
    config SERVO_A_GPIO
        int "Servo A (PWM) GPIO"
        range 1 48
        default 1
        help
            GPIO for first servo PWM (LEDC).

    config SERVO_B_GPIO
        int "Servo B (PWM) GPIO"
        range 1 48
        default 2
        help
            GPIO for second servo PWM (LEDC).

    config SERVO_LEDC_TIMER_IDX
        int "LEDC timer index (0–3)"
        range 0 3
        default 0

    config SERVO_LEDC_CHANNEL_A
        int "LEDC channel for servo A"
        range 0 7
        default 0

    config SERVO_LEDC_CHANNEL_B
        int "LEDC channel for servo B"
        range 0 7
        default 1
endmenu

menu "Main controller — ICM-20948 (I2C)"
    config ICM_I2C_PORT_NUM
        int "I2C port number"
        range 0 1
        default 0

    config ICM_I2C_SDA_GPIO
        int "I2C SDA GPIO"
        range 0 48
        default 43

    config ICM_I2C_SCL_GPIO
        int "I2C SCL GPIO"
        range 0 48
        default 44

    config ICM_I2C_ADDR_AD1
        bool "Use I2C address 0x69 (AD0 high)"
        default n
        help
            If n, address 0x68 is used (typical AD0 low).

endmenu
```

## projects/main_controller/sdkconfig.defaults
```kconfig
# Espressif IoT Development Framework (ESP-IDF) Project Minimal Configuration
CONFIG_IDF_TARGET="esp32s3"
CONFIG_ESPTOOLPY_FLASH_MODE_AUTO_DETECT=n
CONFIG_ESPTOOLPY_FLASHMODE_QIO=y
CONFIG_ESPTOOLPY_FLASHSIZE_16MB=y
CONFIG_PARTITION_TABLE_CUSTOM=y
CONFIG_PARTITION_TABLE_CUSTOM_FILENAME="partitions.csv"
CONFIG_HEIGHT_UART_PORT=1
CONFIG_HEIGHT_UART_RX_GPIO=18
CONFIG_HEIGHT_UART_TX_GPIO=17
CONFIG_ICM_20948_USE_DMP=y
CONFIG_COMPILER_OPTIMIZATION_PERF=y
CONFIG_SPIRAM=y
CONFIG_SPIRAM_MODE_OCT=y
CONFIG_SPIRAM_XIP_FROM_PSRAM=y
CONFIG_SPIRAM_SPEED_80M=y
CONFIG_ESP_CONSOLE_USB_SERIAL_JTAG=y
CONFIG_ESP_DEFAULT_CPU_FREQ_MHZ_240=y
CONFIG_ESP32S3_DATA_CACHE_LINE_64B=y
CONFIG_FREERTOS_HZ=1000
CONFIG_LOG_VERSION_2=y
CONFIG_LV_USE_CLIB_MALLOC=y
CONFIG_LV_USE_CLIB_STRING=y
CONFIG_LV_USE_CLIB_SPRINTF=y
CONFIG_LV_DEF_REFR_PERIOD=10
CONFIG_LV_FONT_MONTSERRAT_12=y
CONFIG_LV_FONT_MONTSERRAT_20=y
CONFIG_LV_USE_SYSMON=y
CONFIG_LV_USE_PERF_MONITOR=y
CONFIG_IDF_EXPERIMENTAL_FEATURES=y
CONFIG_HEIGHT_SKIP_HW=y
CONFIG_SERVO_SKIP_HW=y
CONFIG_ESP_MAIN_TASK_STACK_SIZE=8192
CONFIG_ESP_TWAI_TIMESTAMP_ENABLE=n
```

## projects/tab5_dashboard/main/Kconfig.projbuild
```kconfig
menu "UWA Jetski - Tab5 Dashboard"

choice TAB5_DASHBOARD_FEED_MODE
    prompt "Dashboard feed source"
    default TAB5_DASHBOARD_FEED_MODE_CAN

    config TAB5_DASHBOARD_FEED_MODE_CAN
        bool "CAN"

    config TAB5_DASHBOARD_FEED_MODE_DEMO
        bool "DEMO"
endchoice

config TAB5_DASHBOARD_DEMO_HZ
    int "DEMO update rate (Hz)"
    default 60
    range 1 200

endmenu
```

## projects/ws_lcd_dashboard/components/can/Kconfig.projbuild
```kconfig
menu "CAN configuration"

    config CANTX
        int "CAN tranceiver TX GPIO pin"
        default 15

    config CANRX
        int "CAN tranceiver RX GPIO pin"
        default 16

endmenu
```

## projects/ws_lcd_dashboard/components/ws_display/Kconfig.projbuild
```kconfig
menu "Waveshare Display Configuration"

    menu "Display"
        config EXAMPLE_LCD_RGB_BOUNCE_BUFFER_HEIGHT
            int "RGB Bounce buffer height"
            default 10
            help
                Height of bounce buffer. The width of the buffer is the same as that of the LCD.

        config WS_DISPLAY_ROTATION
            int "Display rotation"
            default 180
            help
                Display rotation in degrees. Supported values are 0, 90, 180, and 270.

    endmenu
endmenu
```

## projects/ws_lcd_dashboard/main/Kconfig.projbuild
```kconfig
menu "WS LCD Dashboard feed"

choice WS_LCD_DASHBOARD_FEED_MODE
    prompt "Dashboard feed source"
    default WS_LCD_DASHBOARD_FEED_MODE_CAN

    config WS_LCD_DASHBOARD_FEED_MODE_CAN
        bool "CAN"

    config WS_LCD_DASHBOARD_FEED_MODE_DEMO
        bool "DEMO"
endchoice

config WS_LCD_DASHBOARD_DEMO_HZ
    int "DEMO update rate (Hz)"
    default 60
    range 1 200

endmenu
```

## shared_components/can/Kconfig.projbuild
```kconfig
menu "UWA Jetski - CAN configuration"

    config CANTX
        int "CAN transceiver TX GPIO pin"
        default 12

    config CANRX
        int "CAN transceiver RX GPIO pin"
        default 13

    config CAN_BITRATE
        int "CAN bitrate (bps)"
        default 500000
        help
            CAN bus bitrate in bits per second. Common values: 100000, 250000, 500000, 1000000

    config CAN_TX_QUEUE_DEPTH
        int "CAN TX queue depth"
        default 16
        range 1 32
        help
            Number of frames that can be queued for transmission before blocking/dropping

endmenu
```

## shared_components/dashboard_ui/Kconfig.projbuild
```kconfig
menu "UWA Jetski - Dashboard UI"

config DASHBOARD_UI_THROTTLE_HZ
    int "Max UI patch rate (Hz)"
    default 60
    range 1 200
    help
        Throttle dashboard_ui's primitive setters to avoid overwhelming LVGL.
        CAN and demo both call these primitive setters; throttling happens inside
        dashboard_ui.

endmenu
```

## shared_components/encoder_can/Kconfig.projbuild
```kconfig
menu "UWA Jetski - Briterencoder CAN"

    config ENCODER_DEVICE_ID
        int "Encoder CAN device address (node ID)"
        default 1
        range 1 255
        help
            CAN node address of the Briterencoder. This is also the CAN frame
            identifier used by the encoder. Factory default is 1.

    config ENCODER_RESOLUTION
        int "Encoder single-turn resolution (counts per revolution)"
        default 1024
        range 64 65536
        help
            Number of encoder counts per full revolution. Common values:
            1024 (10-bit), 4096 (12-bit), 16384 (14-bit).
            Must match the physical encoder model.

    config ENCODER_AUTO_PERIOD_MS
        int "Encoder auto-return period (ms)"
        default 50
        range 50 1000
        help
            How often the encoder sends position frames in auto-return mode.
            The Briterencoder manual lists 50 ms as the minimum. Shorter
            periods can make later parameter writes, such as zeroing, fail.

    config ENCODER_MAX_ANGLE_DEG
        int "Rudder maximum deflection angle (degrees)"
        default 45
        range 5 180
        help
            Physical maximum rudder angle from centre in either direction.
            Used to map encoder angle to a 0–100% rudder percentage for the
            control loop (50% = centre).

endmenu
```
